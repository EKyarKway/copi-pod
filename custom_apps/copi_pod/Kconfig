## custom_apps/copi_pod/Kconfig
```kconfig
#For a description of the syntax of this configuration file,
#see the file kconfig-language.txt in the NuttX tools repository.

config CUSTOM_APPS_COPI_POD
        tristate "CoPI-Pod App"
        default n
        ---help---
                Enable the CoPi-Pod App

if CUSTOM_APPS_COPI_POD

config CUSTOM_APPS_COPI_POD_PROGNAME
        string "Program name"
        default "copipod"
        ---help---
                This is the name of the program that will be used when the NSH ELF
                program is installed.

config CUSTOM_APPS_COPI_POD_PRIORITY
        int "CoPI-Pod task priority"
        default 100

config CUSTOM_APPS_COPI_POD_STACKSIZE
        int "CoPi-Pod stack size"
        default 17000

endif
```
